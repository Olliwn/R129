## sysbuild.conf
```
# nRF5340 has two cores. sysbuild auto-builds the ipc_radio image for the
# network core when the app core enables Bluetooth. These hints make the
# HCI transport and the role (peripheral) explicit so the default BLE
# controller image is picked up.

SB_CONFIG_NETCORE_IPC_RADIO=y
SB_CONFIG_NETCORE_IPC_RADIO_BT_HCI_IPC=y
```

## prj.conf
```kconfig
# ---- Logging / console -------------------------------------------------------
CONFIG_LOG=y
CONFIG_LOG_MODE_IMMEDIATE=y
CONFIG_SERIAL=y
CONFIG_UART_CONSOLE=y
CONFIG_PRINTK=y

# ---- Bluetooth LE peripheral -------------------------------------------------
CONFIG_BT=y
CONFIG_BT_PERIPHERAL=y
CONFIG_BT_DEVICE_NAME="R129-Diag"
CONFIG_BT_DEVICE_APPEARANCE=0
CONFIG_BT_MAX_CONN=1
CONFIG_BT_MAX_PAIRED=1

# Allow the custom 128-bit UUID to fit in the advertising payload
CONFIG_BT_GAP_AUTO_UPDATE_CONN_PARAMS=y

# GATT server
CONFIG_BT_GATT_DYNAMIC_DB=y
CONFIG_BT_GATT_CLIENT=n

# Better default throughput for notifications
CONFIG_BT_L2CAP_TX_MTU=247
CONFIG_BT_BUF_ACL_RX_SIZE=251
CONFIG_BT_BUF_ACL_TX_SIZE=251
CONFIG_BT_CTLR_DATA_LENGTH_MAX=251

# ---- Main thread & stack sizes -----------------------------------------------
CONFIG_MAIN_STACK_SIZE=2048
CONFIG_SYSTEM_WORKQUEUE_STACK_SIZE=2048
```

## src/uart_log.c
```c
#include "uart_log.h"

#include <zephyr/sys/printk.h>

void r129_uart_log_heartbeat(uint32_t counter, uint32_t uptime_ms)
{
    printk("R129-CTR %u uptime=%u ms\n", counter, uptime_ms);
}

void r129_uart_log_frame(const uint8_t *frame, size_t len)
{
    if (frame == NULL || len == 0) {
        return;
    }
    printk("R129-FRM");
    for (size_t i = 0; i < len; i++) {
        printk(" %02X", frame[i]);
    }
    printk("\n");
}
```
